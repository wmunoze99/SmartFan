## main/Kconfig.projbuild
```kconfig
menu "Smart fan hardware"

    config FAN_SPEED_1_GPIO
        int "Speed 1 relay GPIO"
        range 0 30
        default 0

    config FAN_SPEED_2_GPIO
        int "Speed 2 relay GPIO"
        range 0 30
        default 1

    config FAN_SPEED_3_GPIO
        int "Speed 3 relay GPIO"
        range 0 30
        default 2

    config FAN_ROTATION_GPIO
        int "Rotation relay GPIO"
        range 0 30
        default 21

    config FAN_RELAY_ACTIVE_HIGH
        bool "Relay inputs are active-high"
        default n
        help
            Disable this when a low GPIO level energizes the relay.

    config FAN_RELAY_SWITCH_DELAY_MS
        int "Break-before-make delay (ms)"
        range 0 2000
        default 100
        help
            Time with all speed relays off before selecting another speed.

endmenu

menu "Smart fan buttons"

    config FAN_BUTTONS_ENABLED
        bool "Enable physical buttons"
        default y

    config FAN_SPEED_BUTTON_GPIO
        int "Speed button GPIO"
        depends on FAN_BUTTONS_ENABLED
        range 0 30
        default 17

    config FAN_ROTATION_BUTTON_GPIO
        int "Rotation button GPIO"
        depends on FAN_BUTTONS_ENABLED
        range 0 30
        default 20

endmenu

menu "Smart fan display"

    config FAN_DISPLAY_ENABLED
        bool "Enable OLED status display"
        default y

    choice FAN_DISPLAY_CONTROLLER
        prompt "OLED controller"
        depends on FAN_DISPLAY_ENABLED
        default FAN_DISPLAY_CONTROLLER_SSD1306
        help
            Select the controller specified by the display manufacturer.
            Both options use a 128x64 I2C display; the controller cannot be
            reliably detected from its I2C address.

        config FAN_DISPLAY_CONTROLLER_SSD1306
            bool "SSD1306 (typically 0.96 inch)"

        config FAN_DISPLAY_CONTROLLER_SH1106
            bool "SH1106 (typically 1.3 inch)"
    endchoice

    config FAN_DISPLAY_SDA_GPIO
        int "OLED SDA GPIO"
        depends on FAN_DISPLAY_ENABLED
        range 0 30
        default 23

    config FAN_DISPLAY_SCL_GPIO
        int "OLED SCL GPIO"
        depends on FAN_DISPLAY_ENABLED
        range 0 30
        default 22

    config FAN_DISPLAY_I2C_ADDRESS
        hex "OLED I2C address"
        depends on FAN_DISPLAY_ENABLED
        range 0x08 0x77
        default 0x3C

endmenu

menu "Smart fan OTA"

    config FAN_OTA_ENABLED
        bool "Enable GitHub HTTPS OTA"
        default y

    config FAN_OTA_RELEASE_URL
        string "Latest firmware URL"
        depends on FAN_OTA_ENABLED
        default ""
        help
            Firmware URL with {display} replaced by ssd1306 or sh1106 according
            to the selected OLED controller. Legacy /smart_fan.bin URLs are
            mapped to the corresponding variant filename automatically.

    config FAN_OTA_STARTUP_DELAY_SECONDS
        int "Initial check delay (seconds)"
        depends on FAN_OTA_ENABLED
        range 10 3600
        default 60

    config FAN_OTA_CHECK_INTERVAL_MINUTES
        int "Successful check interval (minutes)"
        depends on FAN_OTA_ENABLED
        range 1 10080
        default 1

    config FAN_OTA_RETRY_INTERVAL_MINUTES
        int "Retry interval (minutes)"
        depends on FAN_OTA_ENABLED
        range 1 1440
        default 60

endmenu
```

## sdkconfig.defaults
```kconfig
CONFIG_IDF_TARGET="esp32c6"
CONFIG_ESPTOOLPY_FLASHSIZE_4MB=y

CONFIG_BT_ENABLED=y
CONFIG_BT_NIMBLE_ENABLED=y
CONFIG_BT_NIMBLE_ENABLE_CONN_REATTEMPT=n

CONFIG_OPENTHREAD_ENABLED=n
CONFIG_ENABLE_MATTER_OVER_THREAD=n
CONFIG_ESP_MATTER_ENABLE_OPENTHREAD=n
CONFIG_ENABLE_WIFI_STATION=y
CONFIG_WIFI_NETWORK_COMMISSIONING_DRIVER=y

CONFIG_ESP_WIFI_SOFTAP_SUPPORT=n
CONFIG_USE_MINIMAL_MDNS=n

CONFIG_LWIP_IPV6_AUTOCONFIG=y
CONFIG_LWIP_HOOK_IP6_ROUTE_DEFAULT=y
CONFIG_LWIP_HOOK_ND6_GET_GW_DEFAULT=y
CONFIG_LWIP_IPV6_NUM_ADDRESSES=6

CONFIG_PARTITION_TABLE_CUSTOM=y
CONFIG_PARTITION_TABLE_FILENAME="partitions.csv"
CONFIG_PARTITION_TABLE_OFFSET=0xC000

CONFIG_ENABLE_CHIP_SHELL=n
CONFIG_ENABLE_OTA_REQUESTOR=n

CONFIG_BOOTLOADER_APP_ROLLBACK_ENABLE=y
CONFIG_MBEDTLS_CERTIFICATE_BUNDLE=y
CONFIG_MBEDTLS_CERTIFICATE_BUNDLE_DEFAULT_CMN=y

CONFIG_ESP_MATTER_MAX_DYNAMIC_ENDPOINT_COUNT=2
CONFIG_MBEDTLS_HKDF_C=y

CONFIG_MAX_GROUP_KEYS_PER_FABRIC=4

CONFIG_FAN_DISPLAY_ENABLED=y
CONFIG_FAN_DISPLAY_SDA_GPIO=22
CONFIG_FAN_DISPLAY_SCL_GPIO=23
CONFIG_FAN_DISPLAY_I2C_ADDRESS=0x3C

CONFIG_FAN_OTA_ENABLED=y
CONFIG_FAN_OTA_RELEASE_URL="https://github.com/wmunoze99/SmartFan/releases/latest/download/smart_fan.bin"
CONFIG_FAN_OTA_STARTUP_DELAY_SECONDS=60
CONFIG_FAN_OTA_CHECK_INTERVAL_HOURS=24
CONFIG_FAN_OTA_RETRY_INTERVAL_MINUTES=60
```
